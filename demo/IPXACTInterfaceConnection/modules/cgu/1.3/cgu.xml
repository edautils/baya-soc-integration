# cgu: IP-XACT component
VLNV spiritconsortium.org:Leon2RTL:cgu:1.3
Clock generation unit with enhanced register descrption

## Bus interfaces (logical=physical port)
MainClk: slave spiritconsortium.org:busdef.clock:clock:1.0
  CLK=clkin
APBClk: slave spiritconsortium.org:busdef.clock:clock:1.0
  CLK=pclk
APBReset: slave spiritconsortium.org:busdef.reset:reset:1.0
  RESETn=presetn
ambaAPB: slave amba.com:AMBA2:APB:r2p0_4, memory map ambaAPB
  PSELx=psel, PENABLE=penable, PADDR=paddr, PWRITE=pwrite, PWDATA=pwdata, PRDATA=prdata, PCLK=pclk, PRESETn=presetn
clock0_0: master spiritconsortium.org:busdef.clock:clock:1.0
  CLK=clkout[0:0]
clock0_1: master spiritconsortium.org:busdef.clock:clock:1.0
  CLK=clkout[0:0]
clock0_2: master spiritconsortium.org:busdef.clock:clock:1.0
  CLK=clkout[0:0]
clock0_3: master spiritconsortium.org:busdef.clock:clock:1.0
  CLK=clkout[0:0]
clock1_apb0: master spiritconsortium.org:busdef.clock:clock:1.0
  CLK=clkout[1:1]
clock1_1: master spiritconsortium.org:busdef.clock:clock:1.0
  CLK=clkout[1:1]
clock2_0: master spiritconsortium.org:busdef.clock:clock:1.0
  CLK=clkout[2:2]
clock2_1: master spiritconsortium.org:busdef.clock:clock:1.0
  CLK=clkout[2:2]
clock3_0: master spiritconsortium.org:busdef.clock:clock:1.0
  CLK=clkout[3:3]
clock3_1: master spiritconsortium.org:busdef.clock:clock:1.0
  CLK=clkout[3:3]
clock4_0: master spiritconsortium.org:busdef.clock:clock:1.0
  CLK=clkout[4:4]
clock4_1: master spiritconsortium.org:busdef.clock:clock:1.0
  CLK=clkout[4:4]
clock5_0: master spiritconsortium.org:busdef.clock:clock:1.0
  CLK=clkout[5:5]
clock5_1: master spiritconsortium.org:busdef.clock:clock:1.0
  CLK=clkout[5:5]
clock6_0: master spiritconsortium.org:busdef.clock:clock:1.0
  CLK=clkout[6:6]
clock6_1: master spiritconsortium.org:busdef.clock:clock:1.0
  CLK=clkout[6:6]
clock7_0: master spiritconsortium.org:busdef.clock:clock:1.0
  CLK=clkout[7:7]
clock7_1: master spiritconsortium.org:busdef.clock:clock:1.0
  CLK=clkout[7:7]

## Ports
in pclk
in presetn
in psel
in penable
in paddr[11:0]
in pwrite
in pwdata[31:0]
out prdata[31:0]
in clkin
out clkout[7:0]

## Address spaces and blocks
ambaAPB.defaultid4490597: base 0, range 4k, width 32, register

## Registers
Registers are 32-bit, read-write, reset 0x0 unless marked. A register's access mark holds for its fields unless they carry their own. Offsets are from the block's base; lines under a group give offsets from that group; [hi:lo] are bit positions; {n}, {i} and the like mark numbered series; 'fields as' and 'values as' point back to an identical list; <NAME> marks a mode.

## ambaAPB.defaultid4490597
Base 0x00000000
{0x0+4i} clock{i}Divide (i=0..7)
  [7:0] divide — Divide value for clock, 0=no divide, 1=divide by 2, 2=divide by 4, 3=divide by 6, ...
0xFFC IDReg ro reset 0xD00 — ID register
  [31:0] ID

## Notices in the file
Copyright (c) 2007, 2008, 2009 The SPIRIT Consortium.
This work forms part of a deliverable of The SPIRIT Consortium.
Use of these materials are governed by the legal terms and conditions
outlined in the disclaimer available from www.spiritconsortium.org.
This source file is provided on an AS IS basis.  The SPIRIT
Consortium disclaims any warranty express or implied including
any warranty of merchantability and fitness for use for a
particular purpose.
The user of the source file shall indemnify and hold The SPIRIT
Consortium and its members harmless from any damages or liability.
