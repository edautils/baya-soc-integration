# gpio: IP-XACT component
VLNV spiritconsortium.org:Leon2RTL:gpio:1.2

## Parameters
GPI_BITS = 8
GPO_RESET_VALUE = 0x00000000
GPO_BITS = 8

## Bus interfaces (logical=physical port)
IPReset: slave spiritconsortium.org:busdef.reset:reset:1.0
  RESETn=rst_an
APBClk: slave spiritconsortium.org:busdef.clock:clock:1.0
  CLK=pclk
ambaAPB: slave amba.com:AMBA2:APB:r2p0_4, memory map ambaAPB
  PSELx=psel, PENABLE=penable, PADDR=paddr, PWRITE=pwrite, PWDATA=pwdata, PRDATA=prdata, PCLK=pclk

## Ports
in pclk
in psel
in penable
in paddr[11:0]
in pwrite
in pwdata[31:0]
out prdata[31:0]
in rst_an
in gpi[id('gpi')-1:0]
out gpo[id('gpo')-1:0]

## Address spaces and blocks
ambaAPB.defaultid4489839: base 0, range 4k, width 32

## Registers
Registers are 32-bit, read-only, no defined reset value unless marked. A register's access mark holds for its fields unless they carry their own. Offsets are from the block's base; lines under a group give offsets from that group; [hi:lo] are bit positions; {n}, {i} and the like mark numbered series; 'fields as' and 'values as' point back to an identical list; <NAME> marks a mode.

## ambaAPB.defaultid4489839
Base 0x00000000
0x00 inputreg
  [7:0] inputreg_field
0x04 outputreg 8-bit rw reset 0x0
  [7:0] outputreg_field

## Notices in the file
Copyright (c) 2005, 2006, 2007, 2008, 2009 The SPIRIT Consortium.
This work forms part of a deliverable of The SPIRIT Consortium.
Use of these materials are governed by the legal terms and conditions
outlined in the disclaimer available from www.spiritconsortium.org.
This source file is provided on an AS IS basis.  The SPIRIT
Consortium disclaims any warranty express or implied including
any warranty of merchantability and fitness for use for a
particular purpose.
The user of the source file shall indemnify and hold The SPIRIT
Consortium and its members harmless from any damages or liability.
