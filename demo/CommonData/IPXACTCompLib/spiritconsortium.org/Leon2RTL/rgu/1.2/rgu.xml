# rgu: IP-XACT component
VLNV spiritconsortium.org:Leon2RTL:rgu:1.2

## Parameters
delay{n} = {n} (n=0..2)
delay3 = 4
delay4 = 8
delay5 = 0x10
delay6 = 0x20
delay7 = 0x40

## Bus interfaces (logical=physical port)
IPClk: slave spiritconsortium.org:busdef.clock:clock:1.0
  CLK=ipclk
MainReset: slave spiritconsortium.org:busdef.reset:reset:1.0
  RESETn=rstin_an
APBClk: slave spiritconsortium.org:busdef.clock:clock:1.0
  CLK=pclk
APBReset: slave spiritconsortium.org:busdef.reset:reset:1.0
  RESETn=presetn
ambaAPB: slave amba.com:AMBA2:APB:r2p0_4, memory map ambaAPB
  PSELx=psel, PENABLE=penable, PADDR=paddr, PWRITE=pwrite, PWDATA=pwdata, PRDATA=prdata, PCLK=pclk, PRESETn=presetn
reset0_0: master spiritconsortium.org:busdef.reset:reset:1.0
  RESETn=rstout_an[0:0]
reset0_1: master spiritconsortium.org:busdef.reset:reset:1.0
  RESETn=rstout_an[0:0]
reset0_2: master spiritconsortium.org:busdef.reset:reset:1.0
  RESETn=rstout_an[0:0]
reset0_3: master spiritconsortium.org:busdef.reset:reset:1.0
  RESETn=rstout_an[0:0]
reset1_0: master spiritconsortium.org:busdef.reset:reset:1.0
  RESETn=rstout_an[1:1]
reset1_1: master spiritconsortium.org:busdef.reset:reset:1.0
  RESETn=rstout_an[1:1]
reset2_0: master spiritconsortium.org:busdef.reset:reset:1.0
  RESETn=rstout_an[2:2]
reset2_1: master spiritconsortium.org:busdef.reset:reset:1.0
  RESETn=rstout_an[2:2]
reset3_0: master spiritconsortium.org:busdef.reset:reset:1.0
  RESETn=rstout_an[3:3]
reset3_1: master spiritconsortium.org:busdef.reset:reset:1.0
  RESETn=rstout_an[3:3]
reset4_0: master spiritconsortium.org:busdef.reset:reset:1.0
  RESETn=rstout_an[4:4]
reset4_1: master spiritconsortium.org:busdef.reset:reset:1.0
  RESETn=rstout_an[4:4]
reset5_0: master spiritconsortium.org:busdef.reset:reset:1.0
  RESETn=rstout_an[5:5]
reset5_1: master spiritconsortium.org:busdef.reset:reset:1.0
  RESETn=rstout_an[5:5]
reset6_0: master spiritconsortium.org:busdef.reset:reset:1.0
  RESETn=rstout_an[6:6]
reset6_1: master spiritconsortium.org:busdef.reset:reset:1.0
  RESETn=rstout_an[6:6]
reset7_0: master spiritconsortium.org:busdef.reset:reset:1.0
  RESETn=rstout_an[7:7]
reset7_1: master spiritconsortium.org:busdef.reset:reset:1.0
  RESETn=rstout_an[7:7]

## Ports
in pclk
in presetn
in psel
in penable
in paddr[11:0]
in pwrite
in pwdata[31:0]
out prdata[31:0]
in ipclk
in rstin_an
out rstout_an[7:0]

## Address spaces and blocks
ambaAPB.resetDelays: base , range 32, width 32, register
ambaAPB.EEPROM: base , range 32, width 32, register
ambaAPB.Reserved: base , range 4028, width 32, reserved
ambaAPB.idAddressBlock: base , range 4, width 32, register

## Registers
Registers are 32-bit, read-only, reset 0x0 unless marked. A register's access mark holds for its fields unless they carry their own. Offsets are from the block's base; lines under a group give offsets from that group; [hi:lo] are bit positions; {n}, {i} and the like mark numbered series; 'fields as' and 'values as' point back to an identical list; <NAME> marks a mode.

## ambaAPB.resetDelays
Base 0x00000000
0x00 reset0Delay
  [7:0] delay — Delay value for reset 0, 0=no delay, 1=delay by 1 ipclk, 2=delay by 2 ipclk, ...
0x04 reset1Delay reset 0x1
  [7:0] delay — Delay value for reset 1, 0=no delay, 1=delay by 1 ipclk, 2=delay by 2 ipclk, ...
0x08 reset2Delay reset 0x2
  [7:0] delay — Delay value for reset 2, 0=no delay, 1=delay by 1 ipclk, 2=delay by 2 ipclk, ...
0x0C reset3Delay reset 0x4
  [7:0] delay — Delay value for reset 3, 0=no delay, 1=delay by 1 ipclk, 2=delay by 2 ipclk, ...
0x10 reset4Delay reset 0x8
  [7:0] delay — Delay value for reset 4, 0=no delay, 1=delay by 1 ipclk, 2=delay by 2 ipclk, ...
0x14 reset5Delay reset 0x10
  [7:0] delay — Delay value for reset 5, 0=no delay, 1=delay by 1 ipclk, 2=delay by 2 ipclk, ...
0x18 reset6Delay reset 0x20
  [7:0] delay — Delay value for reset 6, 0=no delay, 1=delay by 1 ipclk, 2=delay by 2 ipclk, ...
0x1C reset7Delay reset 0x40
  [7:0] delay — Delay value for reset 7, 0=no delay, 1=delay by 1 ipclk, 2=delay by 2 ipclk, ...

## ambaAPB.EEPROM
Base 0x00000020
{0x0+4i} eeprom[{i}] (i=0..7) rw
  [31:0] data — Scratch memory, EEPROM

## ambaAPB.idAddressBlock
Base 0x00000FFC
0x00 IDReg reset 0xD01 — ID register
  [31:0] ID

## Notices in the file
Copyright (c) 2007 SPIRIT.  All rights reserved.
www.spiritconsortium.org
