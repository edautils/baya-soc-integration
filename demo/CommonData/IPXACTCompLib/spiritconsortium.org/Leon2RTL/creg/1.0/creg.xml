# creg: IP-XACT component
VLNV spiritconsortium.org:Leon2RTL:creg:1.2

## Bus interfaces (logical=physical port)
IPReset: slave spiritconsortium.org:busdef.reset:reset:1.0
  RESETn=rst_an
APBClk: slave spiritconsortium.org:busdef.clock:clock:1.0
  CLK=pclk
ambaAPB: slave amba.com:AMBA2:APB:r2p0_4, memory map ambaAPB
  PSELx=psel, PENABLE=penable, PADDR=paddr, PWRITE=pwrite, PWDATA=pwdata, PRDATA=prdata, PCLK=pclk

## Ports
in pclk
in psel
in penable
in paddr[11:0]
in pwrite
in pwdata[31:0]
out prdata[31:0]
in rst_an

## Address spaces and blocks
ambaAPB.block: base 0, range 4k, width 32

## Registers
Registers are 32-bit, read-write, reset 0x0 unless marked. A register's access mark holds for its fields unless they carry their own. Offsets are from the block's base; lines under a group give offsets from that group; [hi:lo] are bit positions; {n}, {i} and the like mark numbered series; 'fields as' and 'values as' point back to an identical list; <NAME> marks a mode.

## ambaAPB.block
Base 0x00000000
0x00 Reg1
  [31:0] field
0x04 Reg1Alias
  [31:0] field
0x08 Reg2
  [31:0] field write-1-sets
0x0C Reg3 reset 0xFFFFFFFF
  [31:0] field write-1-clears
0x10 Reg4
  [31:0] field write-1-toggles
0x14 Reg5
  [31:0] field write-sets read-clears
0x18 Reg5Alias
  [31:0] field write-clears read-sets
0x1C Reg6
  [31:0] field
0x20 Reg7
  [31:0] field rw-once

## Notices in the file
Copyright (c) 2005, 2006, 2007, 2008, 2009 The SPIRIT Consortium.
This work forms part of a deliverable of The SPIRIT Consortium.
Use of these materials are governed by the legal terms and conditions
outlined in the disclaimer available from www.spiritconsortium.org.
This source file is provided on an AS IS basis.  The SPIRIT
Consortium disclaims any warranty express or implied including
any warranty of merchantability and fitness for use for a
particular purpose.
The user of the source file shall indemnify and hold The SPIRIT
Consortium and its members harmless from any damages or liability.
