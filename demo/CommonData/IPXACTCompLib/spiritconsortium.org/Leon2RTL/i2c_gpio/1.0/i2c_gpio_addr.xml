# i2c_gpio_addr: IP-XACT component
VLNV spiritconsortium.org:Leon2RTL:i2c_gpio_addr:1.0

## Parameters
gpibits = 4
gpobits = 4

## Bus interfaces (logical=physical port)
i2c_slave: slave spiritconsortium.org:busdef.nxp:i2c:1.0, memory map memory
  SCL=scl, SDA=sda

## Ports
in scl
inout sda
in address[9:0]
in gpi[id('gpi')-1:0]
out gpo[id('gpo')-1:0]

## Address spaces and blocks
memory.defaultid4489720: base 0, range 2, width 8

## Registers
Registers are 8-bit, read-only, no defined reset value unless marked. A register's access mark holds for its fields unless they carry their own. Offsets are from the block's base; lines under a group give offsets from that group; [hi:lo] are bit positions; {n}, {i} and the like mark numbered series; 'fields as' and 'values as' point back to an identical list; <NAME> marks a mode.

## memory.defaultid4489720
Base 0x00000000
0x00 inputreg
  [3:0] inputreg_field
0x01 outputreg rw reset 0x0
  [3:0] outputreg_field

## Notices in the file
Copyright (c) 2005, 2006, 2007, 2008, 2009 The SPIRIT Consortium.
This work forms part of a deliverable of The SPIRIT Consortium.
Use of these materials are governed by the legal terms and conditions
outlined in the disclaimer available from www.spiritconsortium.org.
This source file is provided on an AS IS basis.  The SPIRIT
Consortium disclaims any warranty express or implied including
any warranty of merchantability and fitness for use for a
particular purpose.
The user of the source file shall indemnify and hold The SPIRIT
Consortium and its members harmless from any damages or liability.
